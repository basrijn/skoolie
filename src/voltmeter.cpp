/*
 * https://learn.adafruit.com/introducting-itsy-bitsy-32u4/pinouts
 * https://www.adafruit.com/product/1734
 */


#include <SPI.h>
#include <Wire.h>
#include <Adafruit_NeoPixel.h>
#include <Adafruit_GFX.h>
#include <Adafruit_SSD1306.h>

#define SCREEN_WIDTH 128 // OLED display width, in pixels
#define SCREEN_HEIGHT 64 // OLED display height, in pixels

#define VOLTAGE_PROBE A5  // Use the A5 pin to read voltage
#define NUM_SAMPLES 10    // We will sample the voltage 10 times, this increases accuracy of the read

// Pin for the buzzer
#define BUZZER 10

// Declaration for an SSD1306 display connected to I2C (SDA, SCL pins)
#define OLED_RESET     A4 // Reset pin # (or -1 if sharing Arduino reset pin)
Adafruit_SSD1306 display(SCREEN_WIDTH, SCREEN_HEIGHT, &Wire, OLED_RESET);

// Some global variables
float maxVoltage = 0.0; // Will hold the highest voltage since boot
float minVoltage = 60.0; // Lowest voltage since boot
float curVoltage = 0.0; // Latest voltage read
float dispVoltage = 0; // Voltage for display purposes, updates once a second

float upperBatteryVoltage = 12.7;   // Fully charged (but not charging) battery voltage for lead acid
float lowerBatteryVoltage = 10.5;   // Below this is not good for lead acid. Might drop below this under heavy load

float minuteAgoLength = 1.0 * 60.0 * 1000.0; // Set the length of how far we want to look back for the direction of change (in ms)
float minuteAgoVoltage = 0; // Use this to track the voltage over the longer period
float minuteAgoDirection = 0.0; // Store the direction of change in here
float minuteAgoTS = millis();
float lastMeasuredTS = 0.0;

// Fader config
int fader = 0;
int faderStep = 1;
unsigned long faderTS = millis();

// Neopixel pin
#define LED_PIN 9
// How many neopixels do we have
#define LED_COUNT 2
// Declare the strip
Adafruit_NeoPixel strip(LED_COUNT, LED_PIN, NEO_RGB + NEO_KHZ800);

// http://javl.github.io/image2cpp/
static const unsigned char PROGMEM myLogo_bmp [] = {
  0x00, 0x00, 0x00, 0x00, 0x00, 0x00, 0x00, 0x00, 0x00, 0x00, 0x00, 0x00, 0x00, 0x00, 0x00, 0x00,
  0x00, 0x00, 0x00, 0x00, 0x00, 0x00, 0x00, 0x00, 0x00, 0x00, 0x00, 0x00, 0x00, 0x00, 0x00, 0x00,
  0x00, 0x00, 0x7f, 0xff, 0xff, 0xff, 0xff, 0xff, 0xff, 0xff, 0xff, 0xff, 0xff, 0xff, 0xc0, 0x00,
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  0x00, 0x00, 0x00, 0x00, 0x00, 0x00, 0x00, 0x00, 0x00, 0x00, 0x00, 0x00, 0x00, 0x00, 0x00, 0x00
};

float readVoltage() {
  // Analog read of the voltage, ref voltage is 5
  // We will do the sampling SUM_SAMPLES times
  int sum = 0;                    // sum of samples taken
  unsigned char sample_count = 0; // current sample number

  // We sum the sensor values
  while (sample_count < NUM_SAMPLES) {
        sum += analogRead(VOLTAGE_PROBE);
        sample_count++;
        delay(10);
  }
  //Serial.print(".. Raw ADC reading = ");
  //Serial.println( (float)sum / (float)NUM_SAMPLES);

  // float volt = ( ( (float)sum / (float)NUM_SAMPLES ) / (float)1023.0) * (float)5.0 * (float)12.0 ; // 10k + 1k  + 1k voltage divider and a 5V reference (for 60V)
  float volt = ( ( (float)sum / (float)NUM_SAMPLES ) / (float)1023.0) * (float)5.0 * (float)3.193 ; // 2.2k + 1k voltage divider and a 5V reference (for 16V)

  // We round to the nearest 10th
  volt = round(volt*10.0)/10.0;

  return volt;
}

void neoFader() {
  // If we are at the top or bottom end, reverse direction
  
  if (fader >= 250) {
    faderStep = -8;
  }
  else if (fader <= 0) {
    faderStep = 8;
  }
  fader = fader + faderStep;

  // Make sure we never send a value back outside of the expected range (it's an INT, so it will wrap, causing brightness blips)
  if (  fader < 0 ) {
    fader = 0;
  } else if ( fader > 250) {
    fader = 250;
  }

}

void neoByVoltage(float curVoltage) {
  // Sets the color for the neo pixel based on the provided voltage
  if (curVoltage >= upperBatteryVoltage) {
    strip.setPixelColor(0, 0,255, 0);
    strip.setPixelColor(1, 0,255, 0);
  }
  else if (curVoltage <= lowerBatteryVoltage) {
    strip.setPixelColor(0, 255,0, 0); // RED!
    strip.setPixelColor(1, 255,0, 0); // RED!

    // If we are below the lower voltage, do an angry red blink!
    if ( (millis() - faderTS) > 350 ) {
      // It's been a second, flip state
      if (fader <= 0) {
        fader = 254;
        tone(BUZZER, 1500, 500);
      }
      else {
        fader = 0;
      }
      // Reset the timer
      faderTS = millis();
    }
  }
  else {
    strip.setPixelColor(0, 255,90, 0);
    strip.setPixelColor(1, 255,90, 0);
    fader = 254; // Make sure we set full brightness
  }

  // Look at the minuteAgoDirection and the max voltage. If we are moving up from 100% SOC, then we are charging
  if ( (minuteAgoDirection > 0) && (curVoltage > upperBatteryVoltage) ) {
    // Do some cool fading
    neoFader();
  } 
  else if(curVoltage > upperBatteryVoltage) {
    fader = 254;

  }

  strip.setBrightness(fader);
}


void setup() {
  Serial.begin(9600);

  // We need an accurate 5V reference tied to the ARf pin. USe a quality DC-DC converter for that
  // analogReference(EXTERNAL);

  // SSD1306_SWITCHCAPVCC = generate display voltage from 3.3V internally
  if(!display.begin(SSD1306_SWITCHCAPVCC, 0x3D)) { // Address 0x3D for 128x64
    Serial.println(F("SSD1306 allocation failed"));
    for(;;); // Don't proceed, loop forever
  }

  // Clear the buffer
  display.clearDisplay();

  // Show the bus logo
  display.drawBitmap(0, 0,  myLogo_bmp, 128, 64, 1);
  display.display();
  delay(4000);

  // Do the Neopixel config
  strip.begin();
  strip.show(); // Initialize all pixels to 'off'

}

void loop() {
  // Initialize some variables
  static const unsigned long REFRESH_INTERVAL = 1000; // ms between main voltage display update
  static unsigned long lastRefreshTime = 0;

  // Do a voltage read and update maximum and minimum once every 500 ms
  if ( (millis() - lastMeasuredTS ) > 500 ) {
    
    curVoltage = readVoltage();

    // Update min/max if needed
    if (curVoltage > maxVoltage) {
      maxVoltage = curVoltage;
    }
    if (curVoltage < minVoltage) {
      minVoltage = curVoltage;
    }
    lastMeasuredTS = millis();
  
  }

  // See if we want to update the long term tracking voltage
  if ( (millis() - minuteAgoTS) >  minuteAgoLength) {
    Serial.println(".. Updating the long term tracking voltage");
    // If the voltage hasn't changed, don't update anything. Battery charging might be slow. We want to see at least a two tenths change
    if ( abs(curVoltage - minuteAgoVoltage) > 0.2 ) {
      // Update the voltage change, set the direction indicator later
      if (curVoltage > minuteAgoVoltage) {
        minuteAgoDirection = curVoltage - minuteAgoVoltage;
      }
      else {
        minuteAgoDirection = curVoltage - minuteAgoVoltage;
      }
      Serial.print(".... We saw a change of ");
      Serial.println(minuteAgoDirection);
      minuteAgoVoltage = curVoltage;
    }
    else {
      Serial.println(".... We saw no change");
      minuteAgoDirection = 0.0;
    }
    minuteAgoTS = millis();

  }

  display.clearDisplay();

  display.setTextSize(5);             // Normal 1:1 pixel scale
  display.setTextColor(WHITE);        // Draw white text
  display.setCursor(8,27);             // Start at top-left corner

  // Print the large voltage every 1 second
  if(millis() - lastRefreshTime >= REFRESH_INTERVAL)
  {
    lastRefreshTime += REFRESH_INTERVAL;
    dispVoltage = curVoltage;

  } else
  {
    //dispVoltage = readVoltage();
  }
  display.println(dispVoltage,2);

  // Draw the triangles to show charge direction. If 0, then nothing draws
  if (minuteAgoDirection > 0) {
    display.fillTriangle(2,15,14,1,27,15,WHITE);
  }
  else if (minuteAgoDirection < 0) {
    display.fillTriangle(101,1,113,15,126,1,WHITE);
  }

  // Update the smaller min/max numbers
  display.setTextSize(1);
  display.setCursor(33,7);
  display.print(minVoltage,1);
  display.print(" | ");
  display.println(maxVoltage,1);

  // Update the light status
  neoByVoltage(dispVoltage);

  strip.show();

  display.display();
}

